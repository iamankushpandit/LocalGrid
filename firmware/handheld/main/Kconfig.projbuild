## firmware/handheld/main/Kconfig.projbuild
```kconfig
menu "LocalGrid handheld"

config LG_HH_UI_SPIKE
    bool "No-LVGL UI spike (launcher and Status only)"
    default n
    help
        Replaces the LVGL screens with a launcher and Status screen drawn by lg_draw, to measure
        RAM and redraw cost against LVGL. Messaging screens are absent. Not for use.

endmenu
```

## firmware/node/main/Kconfig.projbuild
```kconfig
menu "LocalGrid AP"

    config LG_NODE_GPS_POLLED
        bool "Experiment: read the GPS from the core task's loop instead of a task of its own"
        default n
        help
            The GPS reader's own task holds a 3 KB stack and a 1 KB receive buffer on the one AP
            that has a GPS, which measured about 6 KB poorer than the others on 2026-10-04 and
            could hold one handheld. With this on there is no GPS task: the core task reads the
            UART each pass of its loop and the buffer shrinks to 256 bytes.

            An A/B switch, off by default. It is kept only if a measurement on the AP shows the
            memory comes back and the GPS still sets grid time with no more bad sentences.

    config LG_NODE_LORA_SPARE_RELAY
        bool "Experiment: do not repeat over LoRa a flood whose sender already reaches every peer here"
        default n
        help
            With ESP-NOW down, every AP that receives a flood over LoRa repeats it to its other LoRa
            peers, so three APs in earshot of one another transmit each message three times on a
            channel that carries one frame every few seconds. With this on, an AP that received the
            frame over LoRa does not repeat it when the sender's last HELLO listed every LoRa peer
            this AP has. Alerts are always repeated.

            An A/B switch, off by default: kept only if a run with ESP-NOW off loses fewer messages.

    config LG_NODE_BLE_ADV
        bool "Advertise LocalGrid discovery over BLE"
        default y
        help
            APs advertise the discovery payload over BLE (D4). The classic ESP32 shares one
            radio between Wi-Fi, ESP-NOW, and BLE, so turning this off is an A/B test of
            coexistence: build with it off, flash every AP, and compare the backbone counters
            that `nodes` prints. Keep it on in normal builds.

    config LG_NODE_PMF_CAPABLE
        bool "SoftAP advertises Protected Management Frames (PMF capable)"
        default y
        help
            Normal builds offer PMF (capable, not required). Turning it off is an A/B test
            for handhelds that disassociate with reason 2. Keep it on in normal builds.

    config LG_NODE_HEARTBEAT
        bool "Log an [UP] line every second (uptime, heap, stations, links, frames, events)"
        default y
        help
            Prints uptime, heap, links, handhelds, and time state once a second from the core
            task, so a long capture shows exactly when an AP crashed, browned out, or hung.
            Turn it off for a quiet console.

    config LG_NODE_WIFI_TX_POWER_QDBM
        int "Wi-Fi transmit power ceiling in quarter dBm, 0 for the driver default"
        default 0
        range 0 84
        help
            Radio transmit bursts are the largest current spikes on an AP. On a weak USB supply
            a lower ceiling (for example 52, which is 13 dBm) is an A/B test for brownouts: build
            with it set, flash every AP, and compare brownout counts over the same hours. Range
            and link quality drop as it goes down.

    config LG_NODE_SUPPLY_SENSE_GPIO
        int "Supply sense pin (ADC1 input behind a divider), -1 for none"
        default -1
        range -1 39
        help
            The Elegoo AP boards have no supply sense, so `power` reports only restart causes.
            Wire a divider from 5 V to an ADC1 pin (GPIO32 to GPIO39 on the classic ESP32; for
            example 100 k to 5 V and 100 k to ground, a 2:1 ratio) and set its GPIO here.

    config LG_NODE_SUPPLY_DIVIDER_MILLI
        int "Supply divider ratio in thousandths"
        default 2000
        range 1000 10000
        help
            Supply voltage divided by the voltage at the pin, times 1000. 2000 for equal resistors.

    config LG_NODE_GPS_RX_GPIO
        int "GPS data pin on MAIN (the module's TX), -1 for none"
        default 16
        range -1 39
        help
            MAIN (node 0) listens for NMEA from a GPS module on this pin, UART2 at 9600 baud, and
            once the module has a fix grid time comes from it (D63). GPIO16 is free on the Elegoo
            boards. Other APs never start the reader.

endmenu
```
